## Kconfig
```kconfig
# SPDX-License-Identifier: Apache-2.0
#
# 项目顶层 Kconfig —— 汇入自定义 BSP 驱动的 Kconfig,并声明应用级配置项。

# 引入 out-of-tree BSP 驱动的 Kconfig 树
rsource "drivers/Kconfig"

menu "BMS Emulator Application"

config BMS_VOLTAGE_CHANNELS
	int "电压模拟通道数 (B1~B13)"
	default 13
	help
	  13 串模组对应 13 路独立电压模拟通道(DAC81416 提供 16 通道)。

config BMS_TEMP_CHANNELS
	int "温度模拟通道数"
	default 7
	help
	  7 路独立温度(NTC 阻值)模拟通道。

endmenu

# 继承 Zephyr 主 Kconfig
source "Kconfig.zephyr"
```

## boards/arm/bms_emu_h743/Kconfig.board
```kconfig
# SPDX-License-Identifier: Apache-2.0

config BOARD_BMS_EMU_H743
	bool "BMS Emulator STM32H743 board"
	depends on SOC_STM32H743XX
```

## boards/arm/bms_emu_h743/Kconfig.defconfig
```kconfig
# SPDX-License-Identifier: Apache-2.0

if BOARD_BMS_EMU_H743

config BOARD
	default "bms_emu_h743"

endif # BOARD_BMS_EMU_H743
```

## boards/arm/bms_emu_h743/bms_emu_h743_defconfig
```kconfig
# SPDX-License-Identifier: Apache-2.0
#
# STM32H743 主控板默认配置(板卡专属)。

CONFIG_ARM_MPU=y
CONFIG_HW_STACK_PROTECTION=y

# 时钟/串口
CONFIG_SERIAL=y
CONFIG_CONSOLE=y
CONFIG_UART_CONSOLE=y

# 网络能力(该板带 PHY,故在板级打开)
CONFIG_NETWORKING=y
CONFIG_NET_L2_ETHERNET=y
CONFIG_NET_TCP=y
CONFIG_NET_IPV4=y

# CAN(FDCAN1 控制帧通道)
CONFIG_CAN=y
```

## drivers/Kconfig
```kconfig
# SPDX-License-Identifier: Apache-2.0
#
# 自定义 BSP 驱动的 Kconfig 汇总。
rsource "dac81416/Kconfig"
rsource "can/Kconfig"
rsource "eth/Kconfig"
rsource "sram/Kconfig"
```

## drivers/can/Kconfig
```kconfig
# SPDX-License-Identifier: Apache-2.0

config BSP_CAN
	bool "CAN transceiver BSP layer"
	default y
	depends on CAN
	help
	  CAN 收发 BSP 封装,底层接 Zephyr CAN 子系统,承载 can_protocol 控制帧。
```

## drivers/dac81416/Kconfig
```kconfig
# SPDX-License-Identifier: Apache-2.0

config BSP_DAC81416
	bool "TI DAC81416 16-channel 16-bit DAC (custom BSP driver)"
	default y
	depends on SPI && GPIO
	help
	  16 通道 16 位精密 DAC,SPI 接口 + LDAC 同步锁存。
	  换 DAC 时:新增 drivers/<newdac>/ 驱动 + 关闭本项,上层 voltage_sim 不动。
```

## drivers/eth/Kconfig
```kconfig
# SPDX-License-Identifier: Apache-2.0

config BSP_ETH
	bool "Ethernet PHY BSP layer"
	default y
	help
	  以太网 PHY 复位等板级操作封装,配合 Zephyr Networking 子系统使用。
```

## drivers/sram/Kconfig
```kconfig
# SPDX-License-Identifier: Apache-2.0

config BSP_SRAM
	bool "External SRAM (FMC) BSP layer"
	default y
	help
	  外部 SRAM 初始化与自检,为波形引擎提供 DMA 缓冲区。
```

## dts/bindings/dac/bmsemu,dac81416-ctrl.yaml
```yaml
# SPDX-License-Identifier: Apache-2.0

description: |
  DAC81416 带外控制引脚(RESET / LDAC 同步锁存 / ALARM 报警)。
  由自定义 BSP 驱动 bsp_dac81416 使用,与 SPI 数据通道分离。

compatible: "bmsemu,dac81416-ctrl"

properties:
  reset-gpios:
    type: phandle-array
    required: true
    description: DAC 硬件复位引脚。

  ldac-gpios:
    type: phandle-array
    required: true
    description: LDAC 同步锁存引脚,拉低即同时更新所有通道输出(13 路同步 <100us)。

  alarm-gpios:
    type: phandle-array
    required: true
    description: DAC 报警输出引脚,由 dac_safety 监视。
```

## dts/bindings/dac/bmsemu,dac81416.yaml
```yaml
# SPDX-License-Identifier: Apache-2.0

description: TI DAC81416 16-channel 16-bit precision DAC (SPI)

compatible: "bmsemu,dac81416"

include: [spi-device.yaml]
```

## tests/voltage_sim/testcase.yaml
```yaml
# SPDX-License-Identifier: Apache-2.0
#
# twister 用例:在 PC(native_sim)上验证 voltage_sim 纯逻辑,无需硬件。
tests:
  bms.voltage_sim:
    platform_allow:
      - native_sim
    tags:
      - voltage_sim
      - app
```

## west.yml
```yaml
# west manifest —— BMS 故障模拟装置
#
# T2 workspace 拓扑:本仓库是应用主体,Zephyr 本体与 HAL 作为依赖由 west 拉取到 deps/。
# 换 MCU 时:在 projects 中增删对应厂商 HAL(如 hal_stm32 换成其他),app/ 不动。
#
# 使用:
#   west init -l .        # 以本仓库为 manifest 初始化 workspace
#   west update           # 拉取下方 projects 到 deps/
manifest:
  self:
    # 本应用仓库在 workspace 中的路径
    path: bms-emulator

  remotes:
    - name: zephyrproject-rtos
      url-base: https://github.com/zephyrproject-rtos

  projects:
    # Zephyr 本体。version 请按团队验证过的稳定版锁定(示例 v4.1.0)。
    - name: zephyr
      remote: zephyrproject-rtos
      revision: v4.1.0
      import:
        # 只导入本项目实际用到的 HAL / 模块,避免全量拉取。
        # 换 MCU 时在此增删对应 HAL 名称。
        name-allowlist:
          - hal_stm32        # STM32H743 SoC HAL(含 FDCAN / FMC / ETH)
          - cmsis            # ARM CMSIS
          - littlefs         # 文件系统(数据记录,可选)
          - mbedtls          # 网络加密(可选)

  # 依赖统一放到 workspace 根的 deps/ 下,不与应用源码混放。
  # west 通过 self.path 与各 project 的默认 path 组织目录。
```
